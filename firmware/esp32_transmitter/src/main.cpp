/*
 * PhyAuth-RF transmitter / attacker node — firmware v2.1
 * Board : ESP32-WROOM-32 DevKit  OR  ESP32-S3 DevKitC (N16R8) — pick the
 *         PlatformIO env that matches the board the STX882 is wired to.
 * Radio : STX882 433.92 MHz ASK transmitter
 *
 * Wiring (same on both chips)
 *   STX882 VCC  -> 5V (VIN)   (more RF power; DATA still accepts 3.3 V logic)
 *   STX882 GND  -> GND
 *   STX882 DATA -> GPIO4      (override: -DTX_PIN_NUM=<gpio>)
 *   Antenna     -> 17.3 cm straight wire (quarter wave) or the supplied coil
 *   On-board LED (ESP32 GPIO2 / ESP32-S3 RGB) lights while transmitting.
 *
 * Roles
 *   - "Emulated device": acts like a key fob with configurable timing, so a
 *     single board can stand in for extra transmitters during development.
 *   - "Clone attacker": replays a captured EV1527 code with the victim's
 *     measured clock period. A secure receiver must reject it even though the
 *     code is correct; that is the point of physical-layer authentication.
 *
 * Timing is generated by the RMT peripheral at 100 ns resolution (crystal
 * accurate), not by delayMicroseconds(), so interrupts cannot distort frames.
 *
 * Serial commands @115200 (newline-terminated, replies are JSON lines):
 *   INFO                     current configuration
 *   CODE <hex> [nbits]       payload (default 24-bit EV1527)
 *   T <us>                   elementary period, e.g. T 320.5
 *   FRAMES <n>               frames per press (1..40)
 *   JITTER <ppm>             random per-cycle jitter (RC-oscillator emulation)
 *   SKEW <us>                stretch HIGH / shrink LOW (PA asymmetry emulation)
 *   PROFILE <0..3>           presets: 0=clean clone, 1..3 = emulated fobs
 *   PRESS                    transmit one button press
 *   CLONE <hex> <T_us> [n]   set code + period and transmit (attack)
 *   AUTO <ms>                periodic presses every <ms> (0 = off, default)
 *   The BOOT button (GPIO0) also transmits one press.
 */
#include <Arduino.h>
#include <driver/rmt.h>

#define FW_VERSION   "2.1.0"
#ifndef TX_PIN_NUM
#define TX_PIN_NUM   4
#endif
#define TX_PIN       ((gpio_num_t)TX_PIN_NUM)

#if CONFIG_IDF_TARGET_ESP32S3
#define BOARD_NAME   "esp32s3"
#if ARDUINO_USB_MODE && !ARDUINO_USB_CDC_ON_BOOT
#define HAS_USB_CDC  1               // also talk on the native USB-C port
#endif
#else
#define BOARD_NAME   "esp32"
#define LED_PIN      2
#endif
#ifndef HAS_USB_CDC
#define HAS_USB_CDC  0
#endif
#define BOOT_BTN     0
#define RMT_CH       RMT_CHANNEL_0
#define RMT_DIV      8              // 80 MHz / 8 = 10 MHz -> 100 ns per tick
#define TICK_NS      100
#define MAX_ITEMS    1400           // a whole press (up to 40 frames) as one waveform

static uint64_t code = 0x5A3C91;
static int nbits = 24;
static float t_us = 320.0f;
static int frames_per_press = 10;
static float jitter_ppm = 0.0f;
static float skew_us = 0.0f;
static uint32_t auto_ms = 0;       // never key the band on boot
static int profile = 1;
static uint32_t presses = 0;

static rmt_item32_t items[MAX_ITEMS];
static int n_items = 0;
static int half = 0;  // 0 = fill duration0, 1 = fill duration1

static void say(const char *fmt, ...) {
  char b[256];
  va_list ap;
  va_start(ap, fmt);
  int n = vsnprintf(b, sizeof(b), fmt, ap);
  va_end(ap);
  if (n <= 0) return;
  if (n >= (int)sizeof(b)) n = sizeof(b) - 1;
  Serial.write((const uint8_t *)b, n);
#if HAS_USB_CDC
  if (USBSerial) USBSerial.write((const uint8_t *)b, n);
#endif
}

static int read_cmd_char() {
  if (Serial.available()) return Serial.read();
#if HAS_USB_CDC
  if (USBSerial.available()) return USBSerial.read();
#endif
  return -1;
}

static void tx_led(bool on) {
#if defined(RGB_BUILTIN) && CONFIG_IDF_TARGET_ESP32S3
  neopixelWrite(RGB_BUILTIN, on ? 40 : 0, on ? 12 : 0, 0);
#elif defined(LED_PIN)
  digitalWrite(LED_PIN, on ? HIGH : LOW);
#else
  (void)on;
#endif
}

static float gauss() {  // Box-Muller from the hardware RNG
  float u1 = (esp_random() + 1.0f) / 4294967297.0f;
  float u2 = (esp_random() + 1.0f) / 4294967297.0f;
  return sqrtf(-2.0f * logf(u1)) * cosf(6.2831853f * u2);
}

static void push_raw(uint32_t level, uint32_t ticks) {
  if (n_items >= MAX_ITEMS - 1) return;   // keep room for the end marker
  if (half == 0) {
    items[n_items].level0 = level;
    items[n_items].duration0 = ticks;
    half = 1;
  } else {
    items[n_items].level1 = level;
    items[n_items].duration1 = ticks;
    n_items++;
    half = 0;
  }
}

// Append one level segment; long segments are split (15-bit RMT durations).
static void push(uint32_t level, float us) {
  if (us < 0.2f) us = 0.2f;
  uint32_t ticks = (uint32_t)(us * 1000.0f / TICK_NS + 0.5f);
  while (ticks > 0) {
    uint32_t chunk = ticks > 32000 ? 32000 : ticks;
    push_raw(level, chunk);
    ticks -= chunk;
  }
}

// RC-oscillator model: independent phase noise per elementary cycle, so the
// error of an n-unit segment grows with sqrt(n) (random walk), as in a fob.
static float cycle(int units) {
  float j = jitter_ppm > 0 ? gauss() * jitter_ppm * 1e-6f * sqrtf((float)units) : 0.0f;
  return t_us * (units + j);
}

static void build_frame() {
  // EV1527: sync (1T high, 31T low) then bits: '1' = 3T H + 1T L, '0' = 1T H + 3T L
  push(1, cycle(1) + skew_us);
  push(0, cycle(31) - skew_us);
  for (int b = nbits - 1; b >= 0; b--) {
    bool bit = (code >> b) & 1;
    push(1, cycle(bit ? 3 : 1) + skew_us);
    push(0, cycle(bit ? 1 : 3) - skew_us);
  }
}

// The whole press is one continuous RMT waveform, like a fob's encoder chip.
// (Separate rmt_write_items() calls per frame left ~2 ms of driver latency in
// the last LOW of every frame: a software artifact no real fob has, and it
// corrupted codes ending in a 1 bit.)
static void transmit_press() {
  tx_led(true);
  n_items = 0;
  half = 0;
  for (int f = 0; f < frames_per_press; f++) build_frame();
  push(1, cycle(1) + skew_us);   // closing sync HIGH terminates the last frame
  if (half == 1) {               // terminate the last item
    items[n_items].level1 = 0;
    items[n_items].duration1 = 0;
    n_items++;
  } else {
    items[n_items].val = 0;      // end marker
    n_items++;
  }
  rmt_write_items(RMT_CH, items, n_items, true);
  tx_led(false);
  presses++;
  say("{\"type\":\"tx\",\"press\":%u,\"code\":\"%llx/%d\",\"T_us\":%.2f,\"frames\":%d,\"items\":%d}\n",
      presses, (unsigned long long)code, nbits, t_us, frames_per_press, n_items);
}

static void info() {
  say("{\"type\":\"hello\",\"fw\":\"phyauth-tx\",\"ver\":\"%s\",\"board\":\"%s\",\"code\":\"%llx/%d\",\"T_us\":%.2f,"
                "\"frames\":%d,\"jitter_ppm\":%.0f,\"skew_us\":%.2f,\"auto_ms\":%u,\"profile\":%d}\n",
                FW_VERSION, BOARD_NAME, (unsigned long long)code, nbits, t_us, frames_per_press, jitter_ppm, skew_us,
                auto_ms, profile);
}

static void apply_profile(int p) {
  // Emulated transmitters for development when only one real fob is at hand.
  // These differ by *programmed* timing, which is weaker than real hardware
  // variation; label any results that use them accordingly.
  profile = p;
  switch (p) {
    case 0: jitter_ppm = 0;    skew_us = 0;    break;                       // clean clone
    case 1: jitter_ppm = 2500; skew_us = 18;   t_us = 318.0f; code = 0x5A3C91; break;
    case 2: jitter_ppm = 3500; skew_us = 28;   t_us = 331.0f; code = 0x1E77C4; break;
    case 3: jitter_ppm = 1800; skew_us = 9;    t_us = 305.5f; code = 0x9B0D2A; break;
  }
}

static char buf[80];
static int blen = 0;

static void handle(char *c) {
  for (char *p = c; *p; p++) *p = toupper(*p);
  char hex[24];
  float f = 0;
  int n = 0;
  unsigned u = 0;
  if (!strcmp(c, "PING")) {
    say("{\"type\":\"ack\",\"cmd\":\"PING\"}\n");
  } else if (!strcmp(c, "INFO")) {
    info();
  } else if (!strcmp(c, "PRESS")) {
    transmit_press();
  } else if (sscanf(c, "CLONE %20s %f %d", hex, &f, &n) >= 2) {
    code = strtoull(hex, nullptr, 16);
    nbits = 24;
    t_us = f;
    if (n > 0 && n <= 40) frames_per_press = n;
    apply_profile(0);
    transmit_press();
  } else if (sscanf(c, "CODE %20s %d", hex, &n) >= 1) {
    code = strtoull(hex, nullptr, 16);
    if (n > 0 && n <= 64) nbits = n;
    info();
  } else if (sscanf(c, "T %f", &f) == 1 && f >= 50 && f <= 2000) {
    t_us = f;
    info();
  } else if (sscanf(c, "FRAMES %d", &n) == 1 && n >= 1 && n <= 40) {
    frames_per_press = n;
    info();
  } else if (sscanf(c, "JITTER %f", &f) == 1 && f >= 0 && f <= 50000) {
    jitter_ppm = f;
    info();
  } else if (sscanf(c, "SKEW %f", &f) == 1 && fabsf(f) <= 200) {
    skew_us = f;
    info();
  } else if (sscanf(c, "PROFILE %d", &n) == 1 && n >= 0 && n <= 3) {
    apply_profile(n);
    info();
  } else if (sscanf(c, "AUTO %u", &u) == 1) {
    auto_ms = u;
    info();
  } else {
    say("{\"type\":\"err\",\"msg\":\"unknown command\"}\n");
  }
}

void setup() {
  Serial.begin(115200);
#if HAS_USB_CDC
  USBSerial.begin();
#endif
  pinMode(BOOT_BTN, INPUT_PULLUP);
#if defined(LED_PIN)
  pinMode(LED_PIN, OUTPUT);
#endif
  tx_led(false);

  rmt_config_t cfg = RMT_DEFAULT_CONFIG_TX(TX_PIN, RMT_CH);
  cfg.clk_div = RMT_DIV;
  cfg.tx_config.idle_output_en = true;
  cfg.tx_config.idle_level = RMT_IDLE_LEVEL_LOW;
  cfg.tx_config.carrier_en = false;
  cfg.mem_block_num = 2;          // driver refills from RAM during long presses
  rmt_config(&cfg);
  rmt_driver_install(RMT_CH, 0, 0);

  apply_profile(1);
  delay(300);
  info();
}

void loop() {
  static uint32_t last_auto = 0;
  static bool btn_prev = true;

  int c;
  while ((c = read_cmd_char()) >= 0) {
    char ch = (char)c;
    if (ch == '\n' || ch == '\r') {
      if (blen) { buf[blen] = 0; handle(buf); blen = 0; }
    } else if (blen < (int)sizeof(buf) - 1) {
      buf[blen++] = ch;
    }
  }

  bool btn = digitalRead(BOOT_BTN);
  if (btn_prev && !btn) transmit_press();
  btn_prev = btn;

  if (auto_ms && millis() - last_auto >= auto_ms) {
    last_auto = millis();
    transmit_press();
  }
}
